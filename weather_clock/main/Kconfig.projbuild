## weather_clock/main/Kconfig.projbuild
```kconfig
menu "DeployAlgorithm Configuration"
    config SENSORLIB_ESP_IDF_NEW_API
        int "Sensorlib esp idf new api"
        default 1
        help
            SENSORLIB_ESP_IDF_NEW_API

endmenu
```
